## config/boards/shields/tako/Kconfig.defconfig
```kconfig
if SHIELD_TAKO_LEFT

config ZMK_KEYBOARD_NAME
  default "Tako"

endif

if SHIELD_TAKO_LEFT || SHIELD_TAKO_RIGHT

config ZMK_SPLIT
  default n

config I2C
    default n

endif

if ZMK_BATTERY_REPORTING

choice ZMK_BATTERY_REPORTING_FETCH_MODE
	default ZMK_BATTERY_REPORTING_FETCH_MODE_LITHIUM_VOLTAGE
endchoice

endif
```

## config/dts/bindings/kscan/zmk,kscan-gpio-ec.yml
```yaml
# Copyright (c) 2023 The ZMK Contributors
# SPDX-License-Identifier: MIT

description: EC keyboard matrix controller

compatible: "zmk,kscan-gpio-ec"

include: kscan.yaml

properties:
  row-gpios:
    type: phandle-array
    required: true
  mux-sel-gpios:
    type: phandle-array
    required: true
  mux0-en-gpios:
    type: phandle-array
    required: true
  mux1-en-gpios:
    type: phandle-array
    required: true
  discharge-gpios:
    type: phandle-array
    required: true
  io-channels:
    type: phandle-array
    required: true
  col-channels:
    type: array
    required: true
  muxes:
    type: phandle-array
  power-gpios:
    type: phandle-array
    required: true
  matrix-warm-up-ms:
    type: int
    default: 5
  matrix-relax-us:
    type: int
    default: 6
  adc-read-settle-us:
    type: int
    default: 5
  active-polling-interval-ms:
    type: int
    default: 3
    description: Time between reads in milliseconds.
  idle-polling-interval-ms:
    type: int
    default: 35
  sleep-polling-interval-ms:
    type: int
    default: 3000
```
